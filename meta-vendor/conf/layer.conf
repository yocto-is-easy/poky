## meta-vendor/conf/layer.conf
```bitbake
# We have a conf and classes directory, add to BBPATH
BBPATH .= ":${LAYERDIR}"

# We have recipes-* directories, add to BBFILES
BBFILES += "${LAYERDIR}/recipes-*/*/*.bb \
            ${LAYERDIR}/recipes-*/*/*.bbappend"

BBFILE_COLLECTIONS += "meta-vendor"
BBFILE_PATTERN_meta-vendor = "^${LAYERDIR}/"
BBFILE_PRIORITY_meta-vendor = "6"

LAYERDEPENDS_meta-vendor = "core"
LAYERSERIES_COMPAT_meta-vendor = "dunfell"

DISTRO_FEATURES_append = " systemd"
DISTRO_FEATURES_BACKFILL_CONSIDERED += "sysvinit"
VIRTUAL-RUNTIME_init_manager = "systemd"
VIRTUAL-RUNTIME_initscripts = "systemd-compat-units"
```
